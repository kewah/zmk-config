## config/west.yml
```yaml
manifest:
  remotes:
    - name: zmkfirmware
      url-base: https://github.com/zmkfirmware
    - name: urob
      url-base: https://github.com/urob
  projects:
    - name: zmk
      remote: zmkfirmware
      revision: abb64ba  # Pin before Zephyr 4.1 migration
      import: app/west.yml
    - name: zmk-adaptive-key
      remote: urob
      revision: main
  self:
    path: config
```
